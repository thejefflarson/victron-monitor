## main/Kconfig.projbuild
```kconfig
menu "Monitor Configuration"
    config SSID
        string "WiFi SSID"
        default "myssid"
        help
            SSID (network name) for the example to connect to.

    config PASS
        string "WiFi Password"
        default "mypassword"
        help
            WiFi password (WPA or WPA2) for the example to use.

    config BROKER
        string "MQTT Broker"
        default "wss://mqtt.eclipse.org:443/mqtt"
        help
            MQTT Broker to connect to.
endmenu
```
